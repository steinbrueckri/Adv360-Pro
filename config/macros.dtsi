macro_pw1: macro_pw1 {
  compatible = "zmk,behavior-macro";
  label = "macro_kinesis";
  #binding-cells = <0>;
  bindings = <&kp LS(K)>, <&kp I>, <&kp N>, <&kp E>, <&kp S>, <&kp I>, <&kp S>;
};

macro_pw2: macro_pw2 {
  compatible = "zmk,behavior-macro";
  label = "macro_kinesis";
  #binding-cells = <0>;
  bindings = <&kp LS(K)>, <&kp I>, <&kp N>, <&kp E>, <&kp S>, <&kp I>, <&kp S>;
};
